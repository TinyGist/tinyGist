## workspace_emulation/esp-adfo_fcn/main/Kconfig.projbuild
```kconfig
menu "Example Configuration"
    config ETH_USE_OPENETH
        bool "Use Openeth"
            default y
            help
                Config to use Openeth.
endmenu
```
